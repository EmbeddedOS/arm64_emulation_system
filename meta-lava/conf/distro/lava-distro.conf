## meta-lava/conf/layer.conf
```bitbake
# We have a conf and classes directory, add to BBPATH
BBPATH .= ":${LAYERDIR}"

# We have recipes-* directories, add to BBFILES
BBFILES += "${LAYERDIR}/recipes-*/*/*.bb \
            ${LAYERDIR}/recipes-*/*/*.bbappend"

BBFILE_COLLECTIONS += "meta-lava"

BBFILE_PATTERN_meta-lava = "^${LAYERDIR}/"
BBFILE_PRIORITY_meta-lava = "9"

# Only depends on openembedded-core/meta layer. 
LAYERDEPENDS_meta-lava = "core"
LAYERSERIES_COMPAT_meta-lava = "kirkstone"
```

## meta-lava/conf/machine/include/lava-qemu.inc
```bitbake
# 1. Select qemuboot.bbclass to build `runqemu`.
IMAGE_CLASSES += "qemuboot"

# 2. QEMU machine configuration.
QB_SYSTEM_NAME = "qemu-system-aarch64"
QB_MACHINE = "-machine virt,secure=on,virtualization=on"
QB_CPU = "-cpu cortex-a57"
QB_MEM = "-m 2048"

# Default FSTYPE to boot.
QB_DEFAULT_FSTYPE = "wic.qcow2"
QB_FSINFO = "wic:no-kernel-in-fs"

# Using rootfs as a virtio block device: "-drive id=disk0,file=@ROOTFS@,if=none,format=raw -device virtio-blk-device,drive=disk0"
# Using rootfs as an usb block device: "-device usb-ehci,id=ehci -drive if=none,file=@ROOTFS@,id=disk0,format=raw -device usb-storage,bus=ehci.0,drive=disk0"
# Using rootfs as mmc: "-device sdhci-pci,sd-spec-version=3 -drive if=none,file=@ROOTFS@,format=raw,id=mmc0 -device sd-card,drive=mmc0"

QB_ROOTFS_OPT = "-drive id=disk0,file=@ROOTFS@,if=none,format=qcow2 -device virtio-blk-device,drive=disk0"
QB_DEFAULT_BIOS = "flash.bin"

# Kernel parameters.
QB_KERNEL_ROOT = "/dev/mem"

# Network option.
#QB_TAP_OPT = "-netdev tap,id=net0,ifname=@TAP@,script=no,downscript=no"
#QB_NETWORK_DEVICE = "-device virtio-net-device,netdev=net0,mac=@MAC@"
QB_TAP_OPT = ""
QB_NETWORK_DEVICE = ""

# Serial option.
SERIAL_CONSOLES ?= "115200;ttyAMA0 115200;hvc0"
SERIAL_CONSOLES_CHECK = "${SERIAL_CONSOLES}"
QB_SERIAL_OPT = "-device virtio-serial-pci -chardev null,id=virtcon -device virtconsole,chardev=virtcon"
QB_TCPSERIAL_OPT = "-device virtio-serial-pci -chardev socket,id=virtcon,port=@PORT@,host=127.0.0.1 -device virtconsole,chardev=virtcon"

# Options to append to QEMU.
# QB_OPT_APPEND = "-device virtio-rng-device -device qemu-xhci -device usb-tablet -device usb-kbd"
```

## meta-lava/conf/machine/lava-machine.conf
```bitbake
# 1. Configure Machine for ARMv8 system on QEMU.
DEFAULTTUNE ?= "cortexa57"
require conf/machine/include/arm/armv8a/tune-cortexa57.inc
require conf/machine/include/qemu.inc

# 2. Configure kernel.
PREFERRED_PROVIDER_virtual/kernel ?= "lava-linux"
KERNEL_IMAGETYPE = "Image"


# 3. Configure initrd.
INITRD_IMAGE = "lava-initrd.cpio.gz"
EXTRA_IMAGEDEPENDS:append = " lava-initrd"

# 4. Configure U-Boot.
PREFERRED_PROVIDER_virtual/bootloader ?= "lava-u-boot"
UBOOT_MACHINE = "qemu_arm64_defconfig"
UBOOT_EXTLINUX = "0"
UBOOT_EXTLINUX_ROOT ?= "root=/dev/mem"
UBOOT_EXTLINUX_KERNEL_IMAGE ?= "${KERNEL_IMAGETYPE}"
UBOOT_EXTLINUX_INITRD ?= "${INITRD_IMAGE}"

# 5. Configure Trusted Firmware A.
EXTRA_IMAGEDEPENDS:append = " lava-tfa"
TFA_PLATFORM = "qemu"
TFA_BUILD_TARGET = "all fip"
TFA_INSTALL_TARGET = "flash.bin"
TFA_MBEDTLS = "0"
TFA_DEBUG = "1"

EXTRA_OEMAKE:append:pn-lava-tfa = " BL33=${DEPLOY_DIR_IMAGE}/u-boot.bin"

# 6. Configure partitioned image.
WKS_FILE = "lava.wks"
IMAGE_FSTYPES:append = " wic wic.bmap wic.qcow2"

IMAGE_BOOT_FILES +="${KERNEL_IMAGETYPE} ${INITRD_IMAGE}"

# 6. QEMU configuration.
require include/lava-qemu.inc
```

## meta-lava/conf/machine/virt-lava.conf
```bitbake
# 1. Configure Machine for ARMv8 system on QEMU.
DEFAULTTUNE ?= "cortexa57"
require conf/machine/include/arm/armv8a/tune-cortexa57.inc
require conf/machine/include/qemu.inc

# 2. Configure kernel.
PREFERRED_PROVIDER_virtual/kernel ?= "linux-lava"
KERNEL_IMAGETYPE = "Image"

# 3. Configure U-Boot.
PREFERRED_PROVIDER_virtual/bootloader ?= "u-boot-lava"
UBOOT_MACHINE ?= "qemu_arm64_defconfig"
UBOOT_EXTLINUX = "1"
UBOOT_EXTLINUX_ROOT ?= "root=/dev/mmcblk0p2"
# UBOOT_ENTRYPOINT = "0x60000000"
# UBOOT_LOADADDRESS = "0x60000000"

# 4. Configure Trusted Firmware A.
EXTRA_IMAGEDEPENDS:append = " trusted-firmware-a"
TFA_PLATFORM = "qemu"
TFA_BUILD_TARGET = "fip all"
TFA_INSTALL_TARGET = "bl1 fip"
TFA_MBEDTLS = "0"
EXTRA_OEMAKE:append:pn-trusted-firmware-a = " ARCH=aarch64"
EXTRA_OEMAKE:append:pn-trusted-firmware-a = " BL33=${DEPLOY_DIR_IMAGE}/u-boot.bin"


# 5. Configure partitioned image.
WKS_FILE = "virt-lava.wks"
IMAGE_FSTYPES:append = " wic wic.bmap"

# 6. QEMU configuration.
require include/lava-qemu.inc
```
